// SPDX-License-Identifier: GPL-2.0-or-later OR MIT
/*
 * Copyright (c) 2021 FriendlyElec Computer Tech. Co., Ltd.
 * (http://www.friendlyarm.com)
 *
 * Copyright (c) 2023 FriendlyElec Computer Tech. Co., Ltd.
 * (http://www.friendlyarm.com)
 *
 * Copyright (c) 2023 Zhennan Li <i@nanmu.me>
 */

/dts-v1/;
#include "rk3328-nanopi-r2s.dts"

/ {
	model = "FriendlyElec NanoPi R2S Plus";
	compatible = "friendlyarm,nanopi-r2s-plus", "rockchip,rk3328";
};

&sdmmc_ext {
	vmmc-supply = <&vcc_io_33>;
	vqmmc-supply = <&vcc_18>;
	max-frequency = <150000000>;
	sd-uhs-sdr104;
	status = "okay";

	rtl8822cs@1 {
		reg = <1>;
		compatible = "realtek,rtl8822cs";
	};
};